## conf/layer.conf
```bitbake
# We have a conf and classes directory, add to BBPATH
BBPATH := "${LAYERDIR}:${BBPATH}"

# We have a recipes directory containing both .bb and .bbappend files, add to BBFILES
BBFILES := "${BBFILES} ${LAYERDIR}/meta/recipes-*/*/*.bb \
        ${LAYERDIR}/meta/recipes-*/*/*.bbappend"

BBFILE_COLLECTIONS += "meta-danny-maintenance"
BBFILE_PATTERN_meta-danny-maintenance := "^${LAYERDIR}/"
BBFILE_PRIORITY_meta-danny-maintenance = "10"
```
